## net/batman-adv/Config.in
```kconfig
config KMOD_BATMAN_ADV_DEVEL_DEBUG_LOG
	bool "enable verbose debug logging"
	depends PACKAGE_kmod-batman-adv-devel
	default n
config KMOD_BATMAN_ADV_DEVEL_BLA
        bool "enable bridge loop avoidance"
        depends PACKAGE_kmod-batman-adv-devel
        default y
config KMOD_BATMAN_ADV_DEVEL_BATCTL
	bool "enable batctl"
	depends PACKAGE_kmod-batman-adv-devel
	default y
	help
	  batctl is a more intuitive managment utility for B.A.T.M.A.N.-Advanced.
	  It is an easier method for configuring batman-adv and
	  provides some additional tools for debugging as well.

choice
        prompt "branch selection"
	default KMOD_BATMAN_ADV_DEVEL_BRANCH_MASTER
        help
                Select the branch to be built (if unsure leave default value).

	config KMOD_BATMAN_ADV_DEVEL_BRANCH_MASTER
		bool "master"

        config KMOD_BATMAN_ADV_DEVEL_BRANCH_BATMANV
                bool "batman V routing algorithm"

        config KMOD_BATMAN_ADV_DEVEL_BRANCH_CATWOMAN
                bool "network encoding (alias catwoman)"

        config KMOD_BATMAN_ADV_DEVEL_BRANCH_DAT
                bool "distributed arp table"
endchoice

config KMOD_BATMAN_ADV_DEVEL_BRANCH_NAME
        string
	default "master"	if KMOD_BATMAN_ADV_DEVEL_BRANCH_MASTER
        default "batmanv"	if KMOD_BATMAN_ADV_DEVEL_BRANCH_BATMANV
        default "catwoman"	if KMOD_BATMAN_ADV_DEVEL_BRANCH_CATWOMAN
        default "dat"		if KMOD_BATMAN_ADV_DEVEL_BRANCH_DAT
```
